## app/Kconfig.projbuild
```kconfig
menu "Desk dashboard"

    config DASHBOARD_WIFI_SSID
        string "Wi-Fi network name"
        default ""
        help
            Name (SSID) of the Wi-Fi network the dashboard joins to set its clock from the internet.

    config DASHBOARD_WIFI_PASSWORD
        string "Wi-Fi password"
        default ""
        help
            Password of that Wi-Fi network. It is kept in sdkconfig, which git does not track.

endmenu
```

## sdkconfig.defaults
```kconfig
CONFIG_IDF_TARGET="esp32s3"
CONFIG_ESPTOOLPY_FLASHSIZE_16MB=y
CONFIG_COMPILER_CXX_EXCEPTIONS=n
CONFIG_COMPILER_CXX_RTTI=n
CONFIG_ESP_MAIN_TASK_STACK_SIZE=8192
CONFIG_FREERTOS_HZ=1000
CONFIG_PARTITION_TABLE_SINGLE_APP_LARGE=y
```
